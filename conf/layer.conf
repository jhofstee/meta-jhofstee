## conf/layer.conf
```bitbake
BBPATH .= ":${LAYERDIR}"

BBFILES += " \
    ${LAYERDIR}/recipes-*/*.bb \
    ${LAYERDIR}/recipes-*/*.bbappend \
"

BBFILE_COLLECTIONS += "jhofstee"
BBFILE_PATTERN_jhofstee := "^${LAYERDIR}/"
BBFILE_PRIORITY_jhofstee = "6"

LAYERSERIES_COMPAT_jhofstee = "whinlatter"
```
